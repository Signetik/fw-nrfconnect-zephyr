## boards/arm/atsaml21_xpro/Kconfig.board
```kconfig
# SAM L21 Xplained Pro Board configuration

# Copyright (c) 2018 Bryan O'Donoghue
# SPDX-License-Identifier: Apache-2.0

config BOARD_ATSAML21_XPRO
	bool "SAM L21 Xplained Pro"
	depends on SOC_PART_NUMBER_SAML21J18B
```

## boards/arm/atsaml21_xpro/Kconfig.defconfig
```kconfig
# SAM L21 Xplained Pro board configuration

# Copyright (c) 2018 Bryan O'Donoghue
# SPDX-License-Identifier: Apache-2.0

if BOARD_ATSAML21_XPRO

config BOARD
	default "atsaml21_xpro"

endif # BOARD_ATSAML21_XPRO
```

## boards/arm/atsaml21_xpro/atsaml21_xpro_defconfig
```kconfig
# Copyright (c) 2018 Bryan O'Donoghue
# SPDX-License-Identifier: Apache-2.0
CONFIG_ARM=y
CONFIG_SOC_SERIES_SAML21=y
CONFIG_SOC_PART_NUMBER_SAML21J18B=y
CONFIG_BOARD_ATSAML21_XPRO=y
CONFIG_CORTEX_M_SYSTICK=y
CONFIG_CONSOLE=y
CONFIG_UART_CONSOLE=y
CONFIG_SERIAL=y
CONFIG_UART_SAM0=y
CONFIG_UART_INTERRUPT_DRIVEN=y
CONFIG_GPIO=y
CONFIG_GPIO_SAM0=y
CONFIG_WATCHDOG=y
CONFIG_WDT_SAM0=y
CONFIG_SOC_ATMEL_SAML_XOSC32K=y
CONFIG_SOC_ATMEL_SAML_XOSC32K_AS_MAIN=n
CONFIG_SPI=y
CONFIG_SPI_SAM0=y
CONFIG_PINMUX=y
CONFIG_PINMUX_SAM0=y
```

## boards/arm/signetik_iot/Kconfig.board
```kconfig
# //============================================================================//
# //         Copyright © 2019-2020 Signetik, LLC -- All Rights Reserved         //
# //----------------------------------------------------------------------------//
# //                                                              Signetik, LLC //
# //                                                           www.signetik.com //
# //                                      SPDX-License-Identifier: BSD-4-Clause //
# //============================================================================//
#
# Kconfig - Signetik SigCell board configuration

if SOC_NRF9160_SICA

config BOARD_SIGNETIK_SIGCELL
	bool "Signetik SigCell"

config BOARD_SIGNETIK_SIGCELLNS
	bool "Signetik SigCell non-secure"

config BOARD_SIGNETIK_SIGCELL_MODEM
	bool "Signetik SigCell Modem"

config BOARD_SIGNETIK_SIGCELL_MODEMNS
	bool "Signetik SigCell Modem non-secure"

config BOARD_SIGNETIK_SIGCELL_TEST
	bool "Signetik SigCell Modem"

config BOARD_SIGNETIK_SIGCELL_TESTNS
	bool "Signetik SigCell Modem non-secure"

endif # SOC_NRF9160_SICA
```

## boards/arm/signetik_iot/Kconfig.defconfig
```kconfig
# //============================================================================//
# //         Copyright © 2019-2020 Signetik, LLC -- All Rights Reserved         //
# //----------------------------------------------------------------------------//
# //                                                              Signetik, LLC //
# //                                                           www.signetik.com //
# //                                      SPDX-License-Identifier: BSD-4-Clause //
# //============================================================================//
#
# Kconfig - Signetik SigCell board configuration

if BOARD_SIGNETIK_SIGCELL || BOARD_SIGNETIK_SIGCELLNS || BOARD_SIGNETIK_SIGCELL_MODEM || BOARD_SIGNETIK_SIGCELL_MODEMNS

config BOARD
	default "signetik_sigcell"

if ADC

config ADC_0
	default y

endif # ADC

if I2C

config I2C_2
	default y

endif # I2C

if PWM

config PWM_0
	default y

endif # PWM

if SPI

config SPI_3
	default y

endif # SPI

# For the secure version of the board the firmware is linked at the beginning
# of the flash, or into the code-partition defined in DT if it is intended to
# be loaded by MCUboot. If the secure firmware is to be combined with a non-
# secure image (TRUSTED_EXECUTION_SECURE=y), the secure FW image shall always
# be restricted to the size of its code partition.
# For the non-secure version of the board, the firmware
# must be linked into the code-partition (non-secure) defined in DT, regardless.
# Apply this configuration below by setting the Kconfig symbols used by
# the linker according to the information extracted from DT partitions.

# Workaround for not being able to have commas in macro arguments
DT_CHOSEN_Z_CODE_PARTITION := zephyr,code-partition

if BOARD_SIGNETIK_SIGCELL && TRUSTED_EXECUTION_SECURE

config FLASH_LOAD_SIZE
	default $(dt_chosen_reg_size_hex,$(DT_CHOSEN_Z_CODE_PARTITION))

endif # BOARD_SIGNETIK_SIGCELL && TRUSTED_EXECUTION_SECURE

if BOARD_SIGNETIIK_SIGCELLNS || BOARD_SIGNETIIK_SIGCELL_MODEMNS 

config FLASH_LOAD_OFFSET
	default $(dt_chosen_reg_addr_hex,$(DT_CHOSEN_Z_CODE_PARTITION))

config FLASH_LOAD_SIZE
	default $(dt_chosen_reg_size_hex,$(DT_CHOSEN_Z_CODE_PARTITION))

endif # BOARD_SIGNETIK_SIGCELLNS

endif # BOARD_SIGNETIK_SIGCELL || BOARD_SIGNETIK_SIGCELLNS
```

## boards/arm/signetik_iot/signetik_sigcell_defconfig
```kconfig
# //============================================================================//
# //         Copyright © 2019-2020 Signetik, LLC -- All Rights Reserved         //
# //----------------------------------------------------------------------------//
# //                                                              Signetik, LLC //
# //                                                           www.signetik.com //
# //                                      SPDX-License-Identifier: BSD-4-Clause //
# //============================================================================//

CONFIG_ARM=y
CONFIG_SOC_FAMILY_NRF=y
CONFIG_SOC_SERIES_NRF91X=y
CONFIG_SOC_NRF9160_SICA=y
CONFIG_BOARD_SIGNETIK_SIGCELL=y

# Enable MPU
CONFIG_ARM_MPU=y

# Enable TrustZone-M
CONFIG_ARM_TRUSTZONE_M=y

# enable GPIO
CONFIG_GPIO=y

# Enable uart driver
CONFIG_SERIAL=y
CONFIG_UART_0_NRF_UARTE=y

# enable console
CONFIG_CONSOLE=y
CONFIG_UART_CONSOLE=y

# enable regulators
CONFIG_REGULATOR=y
CONFIG_REGULATOR_GENERIC=y
```

## boards/arm/signetik_iot/signetik_sigcell_modemns_defconfig
```kconfig
# //============================================================================//
# //         Copyright © 2019-2020 Signetik, LLC -- All Rights Reserved         //
# //----------------------------------------------------------------------------//
# //                                                              Signetik, LLC //
# //                                                           www.signetik.com //
# //                                      SPDX-License-Identifier: BSD-4-Clause //
# //============================================================================//

CONFIG_ARM=y
CONFIG_SOC_FAMILY_NRF=y
CONFIG_SOC_SERIES_NRF91X=y
CONFIG_SOC_NRF9160_SICA=y
CONFIG_BOARD_SIGNETIK_SIGCELL_MODEMNS=y

# Enable MPU
CONFIG_ARM_MPU=y

# Enable TrustZone-M
CONFIG_ARM_TRUSTZONE_M=y

# This Board implies building Non-Secure firmware
CONFIG_TRUSTED_EXECUTION_NONSECURE=y

# enable GPIO
CONFIG_GPIO=y

# Enable uart driver
CONFIG_SERIAL=y
CONFIG_UART_0_NRF_UARTE=y
CONFIG_UART_3_NRF_UARTE=y

# enable console
CONFIG_CONSOLE=y
CONFIG_UART_CONSOLE=y

# enable tty-uart
CONFIG_CONSOLE_SUBSYS=y
CONFIG_CONSOLE_GETCHAR=y
# CONFIG_CONSOLE_GETLINE is not set
CONFIG_CONSOLE_GETCHAR_BUFSIZE=16
CONFIG_CONSOLE_PUTCHAR_BUFSIZE=16

# Turn off sensors
# CONFIG_SENSOR is not set
# CONFIG_I2C_2 is not set
CONFIG_NRFX_TWIM=y
# CONFIG_NRFX_TWIM0 is not set
# CONFIG_NRFX_TWIM1 is not set
CONFIG_NRFX_TWIM2=y
```

## boards/arm/signetik_iot_lrn/Kconfig.board
```kconfig
# //============================================================================//
# //         Copyright © 2019-2020 Signetik, LLC -- All Rights Reserved         //
# //----------------------------------------------------------------------------//
# //                                                              Signetik, LLC //
# //                                                           www.signetik.com //
# //                                      SPDX-License-Identifier: BSD-4-Clause //
# //============================================================================//
#
# Kconfig - Signetik SigLRN board configuration

if SOC_NRF52840_QIAA

config BOARD_SIGNETIK_SIGLRN
	bool "Signetik SigLRN"

config BOARD_SIGNETIK_SIGLRN_TEST
	bool "Signetik SigLRN Test"

endif # SOC_NRF52840_QIAA
```

## boards/arm/signetik_iot_lrn/Kconfig.defconfig
```kconfig
# //============================================================================//
# //         Copyright © 2019-2020 Signetik, LLC -- All Rights Reserved         //
# //----------------------------------------------------------------------------//
# //                                                              Signetik, LLC //
# //                                                           www.signetik.com //
# //                                      SPDX-License-Identifier: BSD-4-Clause //
# //============================================================================//
#
# Kconfig - Signetik SigCell board configuration

if BOARD_SIGNETIK_SIGLRN || BOARD_SIGNETIK_SIGLRN_TEST

config BOARD
	default "signetik_siglrn"

#if ADC

#config ADC_0
#	default y

#endif # ADC

#if I2C

#config I2C_2
#	default n

#endif # I2C

#if PWM

#config PWM_0
#	default n

#endif # PWM

if SPI

config SPI_0
	default y

endif # SPI

endif # BOARD_SIGNETIK_SIGLRN || BOARD_SIGNETIK_SIGLRN_TEST
```

## boards/arm/signetik_iot_lrn/signetik_siglrn_defconfig
```kconfig
# //============================================================================//
# //         Copyright © 2019-2020 Signetik, LLC -- All Rights Reserved         //
# //----------------------------------------------------------------------------//
# //                                                              Signetik, LLC //
# //                                                           www.signetik.com //
# //                                      SPDX-License-Identifier: BSD-4-Clause //
# //============================================================================//

#CONFIG_ARM=y
CONFIG_SOC_SERIES_NRF52X=y
CONFIG_SOC_NRF52840_QIAA=y
CONFIG_BOARD_SIGNETIK_SIGLRN=y

# Enable MPU
CONFIG_ARM_MPU=y

# enable GPIO
CONFIG_GPIO=y

# Enable uart driver
CONFIG_SERIAL=y
#CONFIG_UART_0_NRF_UART=y

# enable console
CONFIG_CONSOLE=y
CONFIG_UART_CONSOLE=y

# enable tty-uart
CONFIG_CONSOLE_SUBSYS=y
CONFIG_CONSOLE_GETCHAR=y
# CONFIG_CONSOLE_GETLINE is not set
CONFIG_CONSOLE_GETCHAR_BUFSIZE=16
CONFIG_CONSOLE_PUTCHAR_BUFSIZE=16

# enable regulators
#CONFIG_REGULATOR=y
#CONFIG_REGULATOR_GENERIC=y
```

## drivers/regulator/Kconfig
```kconfig
# Kconfig - I2S (Inter-IC Sound) driver configuration options
#
# Copyright (c) 2017 Piotr Mienkowski
# SPDX-License-Identifier: Apache-2.0
#

#
# Regulators
#
menuconfig REGULATOR
	bool "Regulator drivers"
	help
	  Enable support for regulators.

if REGULATOR

config REGULATOR_GENERIC
	bool "Generic Regulator"
	default no
	help
	  Enable support for generic regulator.

config REGULATOR_ALWAYSON
	bool "Regulator Always Enabled"
	default no
	help
	  Force regulator to be on during driver load and remain on.

endif # REGULATOR
```

## drivers/sensor/htu21d/Kconfig
```kconfig
# Kconfig - HTU21D temperature sensor configuration options

#
# Copyright (c) 2016 Firmwave
#
# SPDX-License-Identifier: Apache-2.0
#

menuconfig HTU21D
	bool "HTU21D Temperature Sensor"
	depends on I2C
	help
	  Enable the driver for Texas Instruments HTU21D High-Accuracy Digital
	  Temperature Sensors.

	  The TMP102 is compatible with the HTU21D but is less accurate and has
	  been successfully tested with this driver.

if HTU21D

config HTU21D_NAME
	string "Driver name"
	default "HTU21D"
	help
	  Device name with which the HTU21D sensor is identified.

config HTU21D_I2C_ADDR
	hex "I2C address for HTU21D"
	default 0x40
	help
	  I2C address of the HTU21D sensor.

config HTU21D_I2C_MASTER_DEV_NAME
	string "I2C master where HTU21D is connected"
	default "I2C_2"
	help
	  Specify the device name of the I2C master device to which the
	  HTU21D chip is connected.

endif # HTU21D
```

## drivers/sensor/lis3dh/Kconfig
```kconfig
# Kconfig - LIS3DH Three Axis Accelerometer configuration options

#
# Copyright (c) 2017 Intel Corporation
#
# SPDX-License-Identifier: Apache-2.0
#

menuconfig LIS3DH
	bool "LIS3DH Three Axis Accelerometer"
	depends on I2C
	help
	  Enable SPI/I2C-based driver for LIS2DH, LIS3DH, LSM303DLHC,
	  LIS2DH12, LSM303AGR triaxial accelerometer sensors.

if LIS3DH
	  
choice LIS3DH_TRIGGER_MODE
	prompt "Trigger mode"
	help
	  Specify the type of triggering to be used by the driver.

config LIS3DH_TRIGGER_NONE
	bool "No trigger"

config LIS3DH_TRIGGER_GLOBAL_THREAD
	bool "Use global thread"
	depends on GPIO
	select LIS3DH_TRIGGER

config LIS3DH_TRIGGER_OWN_THREAD
	bool "Use own thread"
	depends on GPIO
	select LIS3DH_TRIGGER

endchoice

config LIS3DH_NAME
	string "Driver name"
	default "LIS3DH"
	help
	  Device name with which the LIS3DH sensor is identified.

config LIS3DH_I2C_ADDR
	hex "I2C address for LIS3DH"
	default 0x18
	help
	  I2C address of the LIS3DH sensor.

config LIS3DH_I2C_MASTER_DEV_NAME
	string "I2C master where LIS3DH is connected"
	default "I2C_2"
	help
	  Specify the device name of the I2C master device to which the
	  LIS3DH chip is connected.

config LIS3DH_TRIGGER
	bool

config LIS3DH_THREAD_PRIORITY
	int "Thread priority"
	depends on LIS3DH_TRIGGER_OWN_THREAD
	default 10
	help
	  Priority of thread used by the driver to handle interrupts.

config LIS3DH_THREAD_STACK_SIZE
	int "Thread stack size"
	depends on LIS3DH_TRIGGER_OWN_THREAD
	default 1024
	help
	  Stack size of thread used by the driver to handle interrupts.

choice
	prompt "Acceleration measurement range"
	default LIS3DH_ACCEL_RANGE_RUNTIME
	help
	  Initial measurement full scale range for acceleration values.

config LIS3DH_ACCEL_RANGE_RUNTIME
	bool "Set at runtime"

config LIS3DH_ACCEL_RANGE_2G
	bool "+/-2g"

config LIS3DH_ACCEL_RANGE_4G
	bool "+/-4g"

config LIS3DH_ACCEL_RANGE_8G
	bool "+/-8g"

config LIS3DH_ACCEL_RANGE_16G
	bool "+/-16g"

endchoice

choice
	prompt "Power mode"
	default LIS3DH_POWER_MODE_NORMAL
	help
	  Choose between normal or low power operation mode for chip at init.

config LIS3DH_POWER_MODE_NORMAL
	bool "normal"

config LIS3DH_POWER_MODE_LOW
	bool "low"

endchoice

choice
	prompt "Output data rate frequency"
	default LIS3DH_ODR_RUNTIME
	help
	  Initial data rate frequency of acceleration data at initialization.
	  Supported values:
	  1Hz, 10Hz, 25Hz, 50Hz, 100Hz, 200Hz, 400Hz in all power modes
	  1620Hz, 5376Hz in low power mode only
	  1344Hz in normal power mode

config LIS3DH_ODR_RUNTIME
	bool "Set at runtime"

config LIS3DH_ODR_1
	bool "1Hz"

config LIS3DH_ODR_2
	bool "10Hz"

config LIS3DH_ODR_3
	bool "25Hz"

config LIS3DH_ODR_4
	bool "50Hz"

config LIS3DH_ODR_5
	bool "100Hz"

config LIS3DH_ODR_6
	bool "200Hz"

config LIS3DH_ODR_7
	bool "400Hz"

config LIS3DH_ODR_8
	bool "1.6KHz"
	depends on LIS3DH_POWER_MODE_LOW

config LIS3DH_ODR_9_NORMAL
	bool "1.25KHz"
	depends on LIS3DH_POWER_MODE_NORMAL

config LIS3DH_ODR_9_LOW
	bool "5KHz"
	depends on LIS3DH_POWER_MODE_LOW

endchoice

endif # LIS3DH
```

## dts/bindings/signetik/signetik,regulators.yaml
```yaml
# Copyright (c) 2018, Linaro Limited
# SPDX-License-Identifier: Apache-2.0

description: Signetik Regulators

compatible: "signetik,regulators"

child-binding:
    description: Signetik Regulator Node
    properties:
       gpios:
          type: phandle-array
          required: true
          description: GPIO for enable
```

## soc/arm/atmel_sam0/saml21/Kconfig.defconfig.series
```kconfig
# Atmel SAML MCU series configuration options

# Copyright (c) 2017 Google LLC.
# SPDX-License-Identifier: Apache-2.0

if SOC_SERIES_SAML21

config SOC_SERIES
	default "saml21"

config SOC_PART_NUMBER
	default "saml21j18b" if SOC_PART_NUMBER_SAML21J18B

config NUM_IRQS
	default 29

config SYS_CLOCK_HW_CYCLES_PER_SEC
	default 16000000

endif # SOC_SERIES_SAML21
```

## soc/arm/atmel_sam0/saml21/Kconfig.soc
```kconfig
# Atmel SAML MCU series

# Copyright (c) 2017 Google LLC.
# SPDX-License-Identifier: Apache-2.0

choice
	prompt "Atmel SAML21 MCU Selection"
	depends on SOC_SERIES_SAML21

config SOC_PART_NUMBER_SAML21J18B
	bool "SAML21J18B"

endchoice
```
