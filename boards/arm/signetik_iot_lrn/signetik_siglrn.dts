/*
 * Copyright (c) 2018-2020 Nordic Semiconductor ASA
 * Copyright (c) 2017 Linaro Limited
 *
 * SPDX-License-Identifier: Apache-2.0
 */

/dts-v1/;
#include <nordic/nrf52840_qiaa.dtsi>
#include "signetik_siglrn_common.dts"
/ {
	chosen {
		zephyr,sram = &sram0;
		zephyr,flash = &flash0;
	};
};
